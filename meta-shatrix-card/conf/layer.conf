## meta-shatrix-card/conf/layer.conf
```bitbake
# We have a conf and classes directory, append to BBPATH
BBPATH .= ":${LAYERDIR}"

# We have a recipes directory containing .bb and .bbappend files, add to BBFILES
BBFILES += "${LAYERDIR}/recipes*/*/*.bb \
            ${LAYERDIR}/recipes*/*/*.bbappend"

BBFILE_COLLECTIONS += "shatrix-card"
BBFILE_PATTERN_shatrix-card := "^${LAYERDIR}/"
BBFILE_PRIORITY_shatrix-card = "13"

LAYERSERIES_COMPAT_shatrix-card = "zeus"
```
